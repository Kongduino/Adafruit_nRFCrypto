// Example: RSA-2048 PKCS#1 v1.5 sign/verify using the CC310 hardware.
//
// There is no on-device RSA key generation in this library: 2048-bit keygen
// is impractically slow on a Cortex-M4, even with the CC310's PKA modexp
// acceleration. Instead, the key below was generated once, offline, with:
//   openssl genrsa -out key.pem 2048
// and its N / D / E values extracted as raw Big-Endian byte arrays. In a
// real project you would provision the private key like this (or better,
// keep it out of source and load it from flash/secure storage) and treat
// the modulus/public exponent as the shareable public key.

#include <Adafruit_nRFCrypto.h>

// --- Demo-only RSA-2048 key pair (not for production use) ---
static const uint8_t rsaModulus[256] = {
  0xA5,
  0x2F,
  0xE9,
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  0x9B,
};

static const uint8_t rsaPrivExponent[256] = {
  0x14,
  0xC0,
  0xAF,
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  0xA9,
};

static const uint8_t rsaPubExponent[3] = { 0x01, 0x00, 0x01 };  // 65537

nRFCrypto_RSA_PublicKey rsaPub;
nRFCrypto_RSA_PrivateKey rsaPriv;

static void printHex(const uint8_t* buf, size_t len) {
  for (size_t i = 0; i < len; i++) {
    if (buf[i] < 0x10) Serial.print('0');
    Serial.print(buf[i], HEX);
  }
  Serial.println();
}

void setup() {
  Serial.begin(115200);
  while (!Serial) delay(10);  // remove if running without a serial monitor
  Serial.println("--- nRFCrypto_RSA demo (RSA-2048, PKCS#1 v1.5) ---");

  nRFCrypto.begin();

  if (!rsaPub.begin(rsaModulus, sizeof(rsaModulus), rsaPubExponent, sizeof(rsaPubExponent))) {
    Serial.println("Public key build failed");
    while (1)
      ;
  }
  if (!rsaPriv.begin(rsaModulus, sizeof(rsaModulus), rsaPrivExponent, sizeof(rsaPrivExponent),
                     rsaPubExponent, sizeof(rsaPubExponent))) {
    Serial.println("Private key build failed");
    while (1)
      ;
  }
  Serial.print("Modulus size: ");
  Serial.print(rsaPub.getModulusSize() * 8);
  Serial.println(" bits");

  const char* text = "Hello from Arduino nRF52840!";
  const uint8_t* msg = (const uint8_t*)text;
  size_t msg_len = strlen(text);

  uint8_t sig[256];  // must be >= rsaPub.getModulusSize()
  uint32_t t0 = millis();
  uint16_t sigLen = nRFCrypto_RSA::sign(rsaPriv, CRYS_RSA_HASH_SHA256_mode, msg, msg_len, sig, sizeof(sig));
  uint32_t signMs = millis() - t0;
  if (sigLen == 0) {
    Serial.println("Sign failed");
    while (1)
      ;
  }
  Serial.print("Signature (");
  Serial.print(signMs);
  Serial.println(" ms):");
  printHex(sig, sigLen);

  t0 = millis();
  bool ok = nRFCrypto_RSA::verify(rsaPub, CRYS_RSA_HASH_SHA256_mode, msg, msg_len, sig, sigLen);
  Serial.print("Verify (good msg, ");
  Serial.print(millis() - t0);
  Serial.print(" ms): ");
  Serial.println(ok ? "VALID" : "INVALID");

  // Tamper test: flip one bit, verification should fail
  uint8_t bad[256];
  memcpy(bad, sig, sigLen);
  bad[0] ^= 1;
  Serial.print("Verify (bad sig):  ");
  Serial.println(nRFCrypto_RSA::verify(rsaPub, CRYS_RSA_HASH_SHA256_mode, msg, msg_len, bad, sigLen) ? "VALID (unexpected!)" : "INVALID (expected)");
}

void loop() {}
